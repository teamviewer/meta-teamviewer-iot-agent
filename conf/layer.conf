## conf/layer.conf
```bitbake
# We have a conf and classes directory, add to BBPATH
BBPATH .= ":${LAYERDIR}"

# We have recipes-* directories, add to BBFILES
BBFILES += "${LAYERDIR}/recipes-*/*/*.bb \
            ${LAYERDIR}/recipes-*/*/*.bbappend"

BBFILE_COLLECTIONS += "teamviewer-iot-agent"
BBFILE_PATTERN_teamviewer-iot-agent = "^${LAYERDIR}/"
BBFILE_PRIORITY_teamviewer-iot-agent = "6"

LAYERDEPENDS_teamviewer-iot-agent = "core"
LAYERSERIES_COMPAT_teamviewer-iot-agent = "warrior zeus"
```
